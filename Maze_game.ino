#include <Wire.h>
#include <Adafruit_SSD1306.h>
#include <Adafruit_GFX.h>

Adafruit_SSD1306 display(128, 64, &Wire, -1);

const unsigned char myBitmap [] PROGMEM = {
	0xff, 0xff, 0xff, 0xff, 0xff, 0xff, 0xff, 0xff, 0xff, 0xff, 0xff, 0xff, 0xff, 0xff, 0xff, 0xff, 
	0xff, 0xff, 0xff, 0xff, 0xff, 0xff, 0xff, 0xff, 0xff, 0xff, 0xff, 0xff, 0xff, 0xff, 0xff, 0xff, 
	0xff, 0xff, 0xff, 0xff, 0xff, 0xff, 0xff, 0xff, 0xff, 0xff, 0xff, 0xff, 0xff, 0xff, 0xff, 0xff, 
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	0xff, 0xff, 0xff, 0xff, 0xff, 0xff, 0xff, 0xff, 0xff, 0xff, 0xff, 0xff, 0xff, 0xff, 0xff, 0xff
};

// Joystick pins
int x_pin = A1;
int y_pin = A0;
int s_pin = 2;

// Joystick values
int x_val;
int y_val;
int s_val;

// Player position
int player_x = 42;
int player_y = 49;

//Player size
int player_radius=2;

// ----- Function to check if a wall is at (x, y) -----
bool is_wall(int x, int y) {
  if (x < 0 || x >= 128 || y < 0 || y >= 64) return true; // block outside screen
  int byte_width = 128 / 8; // 16 bytes per row
  int byte_index = y * byte_width + (x / 8);
  int bit_index = 7 - (x % 8);
  byte pixel_byte = pgm_read_byte(&myBitmap[byte_index]);
  return (pixel_byte >> bit_index) & 0x01;
}// is_wall() ends



// ----- Setup -----
void setup() {
  display.begin(SSD1306_SWITCHCAPVCC, 0x3C);
  display.clearDisplay();
  delay(20);
  pinMode(x_pin, INPUT);
  pinMode(y_pin, INPUT);
	pinMode(s_pin, INPUT_PULLUP);
  Serial.begin(9600);
}//setup() ends

// ----- Loop -----
void loop() {
  // Draw maze
  display.drawBitmap(0, 0, myBitmap, 128, 64, WHITE);
  

  // Draw player
  display.fillCircle(player_x, player_y, player_radius, WHITE);
  display.display();

  // Joystick input
  x_val = analogRead(x_pin);
  y_val = analogRead(y_pin);
	s_val = digitalRead(s_pin);

  // Move the player
  player_control();
	// Winning board
	player_win();

  // Debug output
  Serial.print("Player: ");
  Serial.print(player_x);
  Serial.print(", ");
  Serial.print(player_y);
  Serial.print("  |  Joystick: ");
  Serial.print(x_val);
  Serial.print(" , ");
  Serial.print(y_val);
	Serial.print(" , ");
  Serial.println(s_val);	
}// lopp() ends

// ----- Player movement with collision -----
void player_control() {
  int new_x = player_x;
  int new_y = player_y;

  // Up
  if (x_val == 512 && y_val == 1023) {
    new_y = player_y - 2;
  }

  // Down
  if (x_val == 512 && y_val == 0) {
    new_y = player_y + 2;
  }

  // Left
  if (x_val == 1023 && y_val == 512) {
    new_x = player_x - 2;
  }

  // Right
  if (x_val == 0 && y_val == 512) {
    new_x = player_x + 2;
  }

  // Only move if not hitting a wall
  if (!is_wall(new_x, new_y)) {
    display.display();
    display.fillCircle(player_x, player_y, player_radius, BLACK); // erase old
    player_x = new_x;
    player_y = new_y;
    display.fillCircle(player_x, player_y, player_radius, WHITE); // draw new
    display.display();
  }	
	}//player_control() ends

	void player_win(){

		if (player_x >= 82 && player_x <= 88 && player_y >=13 && player_y <= 15){
		
		delay(200);
		display.clearDisplay();
		display.display();

		display.setTextSize(1);
		display.setTextColor(WHITE);
		display.setCursor(39,30);
		display.println("YOU WON!!");
		display.drawRect(32, 25, 65, 16, WHITE);

		display.display();
		delay(100000);
	}
	}//player_win() ends
